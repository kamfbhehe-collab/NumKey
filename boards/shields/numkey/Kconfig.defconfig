## boards/shields/numkey/Kconfig.defconfig
```kconfig
if SHIELD_NUMKEY_LEFT

config ZMK_KEYBOARD_NAME
    default "numkey"

endif

if SHIELD_NUMKEY_LEFT || SHIELD_NUMKEY_RIGHT

config ZMK_SPLIT
    default y

endif
```

## boards/shields/numkey/Kconfig.shield
```kconfig
config SHIELD_NUMKEY_LEFT
    def_bool $(shields_list_contains,numkey_left)
config SHIELD_NUMKEY_RIGHT
    def_bool $(shields_list_contains,numkey_right)
```
